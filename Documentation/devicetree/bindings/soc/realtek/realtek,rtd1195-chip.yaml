## Documentation/devicetree/bindings/soc/realtek/realtek,rtd1195-chip.yaml
```yaml
# SPDX-License-Identifier: (GPL-2.0-or-later OR BSD-2-Clause)
%YAML 1.2
---
$id: "http://devicetree.org/schemas/soc/realtek/realtek,rtd1195-chip.yaml#"
$schema: "http://devicetree.org/meta-schemas/core.yaml#"

title: Realtek RTD1195 chip identification

maintainers:
  - Andreas Färber <afaerber@suse.de>

description: |
  The Realtek SoCs have some registers to identify the chip and revision.
  To identify the exact model within a family, further registers are needed.

properties:
  compatible:
    const: "realtek,rtd1195-chip"

  reg:
    minItems: 1
    maxItems: 2

required:
  - compatible
  - reg

examples:
  - |
    chip-info@1801a200 {
        compatible = "realtek,rtd1195-chip";
        reg = <0x1801a200 0x8>;
    };
  - |
    chip-info@9801a200 {
        compatible = "realtek,rtd1195-chip";
        reg = <0x9801a200 0x8>,
              <0x98007028 0x4>;
    };
...
```

## Documentation/devicetree/bindings/usb/ch482d-gpio-switch.yaml
```yaml
# SPDX-License-Identifier: GPL-2.0-only OR BSD-2-Clause
%YAML 1.2
---
$id: "http://devicetree.org/schemas/usb/ch482d-gpio-switch.yaml#"
$schema: "http://devicetree.org/meta-schemas/core.yaml#"

title: CH482D GPIO-based switch

maintainers:
  - Bjorn Andersson <bjorn.andersson@linaro.org>

description:
  In USB Type-C applications the main chip needs to be connected, disconnected
  and swapped depending on the orientation. This binding describes the CH482D
  which performs this based on simple GPIO control.

properties:
  compatible:
    items:
      - enum:
          - wcn,ch482d
      - const: ch482d-gpio-switch

  enable-gpios:
    description: Switch enable GPIO

  select-gpios:
    description: Orientation select

  vcc-supply:
    description: power supply

  mode-switch:
    description: Flag the port as possible handle of altmode switching
    type: boolean

  orientation-switch:
    description: Flag the port as possible handler of orientation switching
    type: boolean

  port:
    $ref: /schemas/graph.yaml#/properties/port
    description:
      A port node to link the SBU mux to a TypeC controller for the purpose of
      handling altmode muxing and orientation switching.

required:
  - compatible
  - select-gpios
  - orientation-switch
  - port

additionalProperties: false

examples:
  - |
    #include <dt-bindings/gpio/gpio.h>

    ch482d-mux {
      compatible = "wcn,ch482d", "ch482d-gpio-switch";

      /* enabled through pull-down */
      select-gpios = <&gpio GPIOC_7 GPIO_ACTIVE_LOW>;

      orientation-switch;

      port {
        endpoint {
          remote-endpoint = <&typec_ss>;
        };
      };
    };
...
```

## Documentation/devicetree/bindings/usb/gpio-ch482d-mux.yaml
```yaml
# SPDX-License-Identifier: GPL-2.0-only OR BSD-2-Clause
%YAML 1.2
---
$id: "http://devicetree.org/schemas/usb/gpio--mux-ch482d.yaml#"
$schema: "http://devicetree.org/meta-schemas/core.yaml#"

title: CH482D GPIO-based mux

maintainers:
  - Bjorn Andersson <bjorn.andersson@linaro.org>

description:
  In USB Type-C applications the main chip needs to be connected, disconnected
  and swapped depending on the orientation. This binding describes the CH482D
  which performs this based on simple GPIO control.

properties:
  compatible:
    items:
      - enum:
          - wcn,ch482d
      - const: gpio-ch482d-mux

  enable-gpios:
    description: Switch enable GPIO

  select-gpios:
    description: Orientation select

  vcc-supply:
    description: power supply

  mode-switch:
    description: Flag the port as possible handle of altmode switching
    type: boolean

  orientation-switch:
    description: Flag the port as possible handler of orientation switching
    type: boolean

  port:
    $ref: /schemas/graph.yaml#/properties/port
    description:
      A port node to link the SBU mux to a TypeC controller for the purpose of
      handling altmode muxing and orientation switching.

required:
  - compatible
  - enable-gpios
  - select-gpios
  - mode-switch
  - orientation-switch
  - port

additionalProperties: false

examples:
  - |
    #include <dt-bindings/gpio/gpio.h>

    ch482d-mux {
      compatible = "wcn,ch482d", "gpio-ch482d-mux";

      enable-gpios = <&tlmm 101 GPIO_ACTIVE_LOW>;
      select-gpios = <&tlmm 164 GPIO_ACTIVE_HIGH>;

      mode-switch;
      orientation-switch;

      port {
        endpoint {
          remote-endpoint = <&pmic_glink_dp0_sbu>;
        };
      };
    };
...
```
