// SPDX-License-Identifier: (GPL-2.0+ OR MIT)
/*
 * Copyright (c) 2018 BayLibre SAS. All rights reserved.
 */

/dts-v1/;

#include "meson-g12a-x96-max.dtsi"

/ {
	compatible = "amediatech,x96-max-1000", "amlogic,u200", "amlogic,g12a";
	model = "Shenzhen Amediatech Technology Co., Ltd X96 Max";
};

&ethmac {
	pinctrl-0 = <&eth_rmii_pins>, <&eth_rgmii_pins>;
	pinctrl-names = "default";
	status = "okay";
	phy-mode = "rgmii";
	phy-handle = <&external_phy>;
	amlogic,tx-delay-ns = <2>;
	snps,reset-gpio = <&gpio GPIOZ_14 0>;
	snps,reset-delays-us = <0 10000 1000000>;
	snps,reset-active-low;
};
